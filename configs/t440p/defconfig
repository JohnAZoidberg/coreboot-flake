## configs/t440p/defconfig
```kconfig
# Base
CONFIG_VENDOR_LENOVO=y
CONFIG_BOARD_LENOVO_THINKPAD_T440P=y
CONFIG_PCIEXP_HOTPLUG=y
CONFIG_H8_SUPPORT_BT_ON_WIFI=y
CONFIG_DRIVERS_PS2_KEYBOARD=y

# Coreboot
CONFIG_TIMESTAMPS_ON_CONSOLE=y
CONFIG_USE_OPTION_TABLE=y

# Preferences
CONFIG_SECURITY_CLEAR_DRAM_ON_REGULAR_BOOT=y
CONFIG_TPM_DEACTIVATE=y
CONFIG_EDK2_DISABLE_TPM=y

# Display
CONFIG_GENERIC_LINEAR_FRAMEBUFFER=y

# Blobs
CONFIG_HAVE_ME_BIN=y
CONFIG_CHECK_ME=y
CONFIG_USE_ME_CLEANER=y
CONFIG_ME_BIN_PATH="flashregion_2_intel_me.bin"

CONFIG_HAVE_GBE_BIN=y
CONFIG_GBE_BIN_PATH="flashregion_3_gbe.bin"

CONFIG_HAVE_IFD_BIN=y
CONFIG_VALIDATE_INTEL_DESCRIPTOR=y
CONFIG_IFD_BIN_PATH="flashregion_0_flashdescriptor.bin"

CONFIG_HAVE_MRC=y
CONFIG_MRC_FILE="mrc.bin"

# UEFI
CONFIG_PAYLOAD_EDK2=y
CONFIG_EDK2_REPOSITORY="https://github.com/MrChromebox/edk2"
CONFIG_EDK2_TAG_OR_REV="78c2b10586e58b23920ec0f4d3cc1cf5fdd0b979"
CONFIG_EDK2_USE_EDK2_PLATFORMS=y
CONFIG_EDK2_FOLLOW_BGRT_SPEC=y
CONFIG_CBFS_SIZE=0x300000
```

## configs/vp4670/defconfig
```kconfig
CONFIG_LOCALVERSION="mateidibu-flake"
CONFIG_VENDOR_PROTECTLI=y
CONFIG_MAINBOARD_PART_NUMBER="VP4670"
CONFIG_MAINBOARD_VERSION="3.7.0"
CONFIG_ONBOARD_VGA_IS_PRIMARY=y
CONFIG_DISABLE_HECI1_AT_PRE_BOOT=y
# CONFIG_USE_PM_ACPI_TIMER is not set
CONFIG_IFD_BIN_PATH="flashregion_0_flashdescriptor.bin"
CONFIG_ME_BIN_PATH="flashregion_2_intel_me.bin"
CONFIG_CONSOLE_CBMEM_BUFFER_SIZE=0x100000
CONFIG_EDK2_BOOT_TIMEOUT=4
CONFIG_HAVE_IFD_BIN=y
CONFIG_BOARD_PROTECTLI_VP46XX=y
CONFIG_USE_INTEL_FSP_MP_INIT=y
CONFIG_X2APIC_ONLY=y
CONFIG_VALIDATE_INTEL_DESCRIPTOR=y
CONFIG_HAVE_ME_BIN=y
CONFIG_ME_REGION_ALLOW_CPU_READ_ACCESS=y
CONFIG_RUN_FSP_GOP=y
CONFIG_DRIVERS_EFI_VARIABLE_STORE=y
CONFIG_DRIVERS_GENERIC_CBFS_SERIAL=y
CONFIG_DRIVERS_GENERIC_CBFS_UUID=y
CONFIG_TPM2=y
CONFIG_PAYLOAD_EDK2=y
CONFIG_EDK2_REPOSITORY="https://github.com/MrChromebox/edk2"
CONFIG_EDK2_TAG_OR_REV="78c2b10586e58b23920ec0f4d3cc1cf5fdd0b979"
CONFIG_EDK2_USE_EDK2_PLATFORMS=y
CONFIG_EDK2_FOLLOW_BGRT_SPEC=y
```

## packages/t480/defconfig
```kconfig
# Base
CONFIG_VENDOR_LENOVO=y
CONFIG_BOARD_LENOVO_T480=y

# Blobs
CONFIG_HAVE_ME_BIN=y
CONFIG_CHECK_ME=y
CONFIG_USE_ME_CLEANER=y
CONFIG_ME_BIN_PATH="blobs/me.bin"

CONFIG_HAVE_GBE_BIN=y
CONFIG_GBE_BIN_PATH="blobs/gbe.bin"

CONFIG_HAVE_IFD_BIN=y
CONFIG_VALIDATE_INTEL_DESCRIPTOR=y
CONFIG_IFD_BIN_PATH="blobs/ifd.bin"

# UEFI
CONFIG_PAYLOAD_EDK2=y
CONFIG_EDK2_REPOSITORY="https://github.com/MrChromebox/edk2"
CONFIG_EDK2_TAG_OR_REV="78c2b10586e58b23920ec0f4d3cc1cf5fdd0b979"
CONFIG_EDK2_USE_EDK2_PLATFORMS=y
CONFIG_EDK2_FOLLOW_BGRT_SPEC=y
```

## packages/vp4670/defconfig
```kconfig
CONFIG_LOCALVERSION="mateidibu-flake"
CONFIG_USE_OPTION_TABLE=y
CONFIG_VENDOR_PROTECTLI=y
CONFIG_MAINBOARD_PART_NUMBER="VP4670"
CONFIG_MAINBOARD_VERSION="3.7.0"
CONFIG_ONBOARD_VGA_IS_PRIMARY=y
CONFIG_DISABLE_HECI1_AT_PRE_BOOT=y
CONFIG_IFD_BIN_PATH="blobs/flashregion_0_flashdescriptor.bin"
CONFIG_ME_BIN_PATH="blobs/flashregion_2_intel_me.bin"
CONFIG_CONSOLE_CBMEM_BUFFER_SIZE=0x100000
CONFIG_EDK2_BOOT_TIMEOUT=4
CONFIG_HAVE_IFD_BIN=y
CONFIG_BOARD_PROTECTLI_VP46XX=y
CONFIG_USE_INTEL_FSP_MP_INIT=y
CONFIG_X2APIC_ONLY=y
CONFIG_VALIDATE_INTEL_DESCRIPTOR=y
CONFIG_HAVE_ME_BIN=y
CONFIG_ME_REGION_ALLOW_CPU_READ_ACCESS=y
CONFIG_RUN_FSP_GOP=y
CONFIG_DRIVERS_GENERIC_CBFS_SERIAL=y
CONFIG_DRIVERS_GENERIC_CBFS_UUID=y
CONFIG_TPM2=y
CONFIG_PAYLOAD_EDK2=y
CONFIG_EDK2_REPOSITORY="https://github.com/MrChromebox/edk2"
CONFIG_EDK2_TAG_OR_REV="ac7f573852a6e17de85c76070ded2ddd6705291d"
CONFIG_EDK2_USE_EDK2_PLATFORMS=y
CONFIG_EDK2_FOLLOW_BGRT_SPEC=y
```

## vp4670/defconfig
```kconfig
CONFIG_TIMESTAMPS_ON_CONSOLE=y
CONFIG_VENDOR_PROTECTLI=y
CONFIG_MAINBOARD_PART_NUMBER="VP4670"
CONFIG_MAINBOARD_VERSION="3.7.0"
CONFIG_ONBOARD_VGA_IS_PRIMARY=y
# CONFIG_POST_DEVICE is not set
CONFIG_DISABLE_HECI1_AT_PRE_BOOT=y
CONFIG_CONSOLE_POST=y
# CONFIG_DRIVERS_INTEL_WIFI is not set
CONFIG_IFD_BIN_PATH="vp4670/flashregion_0_flashdescriptor.bin"
CONFIG_ME_BIN_PATH="vp4670/flashregion_2_intel_me.bin"
CONFIG_HAVE_IFD_BIN=y
CONFIG_BOARD_PROTECTLI_VP46XX=y
CONFIG_USE_INTEL_FSP_MP_INIT=y
# CONFIG_PAVP is not set
CONFIG_X2APIC_ONLY=y
CONFIG_VALIDATE_INTEL_DESCRIPTOR=y
CONFIG_HAVE_ME_BIN=y
CONFIG_ME_REGION_ALLOW_CPU_READ_ACCESS=y
CONFIG_PCIEXP_SUPPORT_RESIZABLE_BARS=y
CONFIG_PCIEXP_LANE_ERR_STAT_CLEAR=y
CONFIG_DRIVERS_EFI_VARIABLE_STORE=y
CONFIG_DISPLAY_FSP_TIMESTAMPS=y
# CONFIG_USE_PC_CMOS_ALTCENTURY is not set
# CONFIG_DRIVERS_MTK_WIFI is not set
CONFIG_DEFAULT_CONSOLE_LOGLEVEL_6=y
CONFIG_MAINBOARD_SERIAL_NUMBER="24.05"
CONFIG_PAYLOAD_EDK2=y
CONFIG_EDK2_REPO_OFFICIAL=y
CONFIG_EDK2_TAG_OR_REV="edk2-stable202402"
CONFIG_EDK2_USE_EDK2_PLATFORMS=y
CONFIG_EDK2_CBMEM_LOGGING=y
CONFIG_EDK2_SERIAL_SUPPORT=y
CONFIG_EDK2_DISABLE_TPM=y
CONFIG_EDK2_CUSTOM_BUILD_PARAMS="-D VARIABLE_SUPPORT=SMMSTORE"
```
